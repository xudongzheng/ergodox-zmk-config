## config/west.yml
```yaml
manifest:
  remotes:
    - name: xudongzheng
      url-base: https://github.com/xudongzheng
  projects:
    - name: zmk
      remote: xudongzheng
      revision: v20251223-rgb
      import: app/west.yml
  self:
    path: config
```
